## Config.in
```kconfig
menu "Zybo Z7 packages"
source "$BR2_EXTERNAL_ZYBO_PATH/package/zybo-btn/Config.in"
source "$BR2_EXTERNAL_ZYBO_PATH/package/zybo-monitor/Config.in"
source "$BR2_EXTERNAL_ZYBO_PATH/package/zybo-health/Config.in"
endmenu
```

## configs/zybo_z7_defconfig
```kconfig
BR2_arm=y
BR2_cortex_a9=y
BR2_ARM_ENABLE_NEON=y
BR2_ARM_ENABLE_VFP=y
BR2_KERNEL_HEADERS_6_1=y
BR2_TARGET_GENERIC_HOSTNAME="zybo"
BR2_TARGET_GENERIC_ISSUE="Zybo Z7 / Buildroot"
BR2_TARGET_GENERIC_ROOT_PASSWD="zybo"
BR2_TARGET_GENERIC_GETTY_PORT="ttyPS0"
BR2_SYSTEM_DHCP="eth0"
BR2_ROOTFS_OVERLAY="$(BR2_EXTERNAL_ZYBO_PATH)/board/zybo-z7/rootfs-overlay"
BR2_ROOTFS_POST_IMAGE_SCRIPT="$(BR2_EXTERNAL_ZYBO_PATH)/board/zybo-z7/post-image.sh"
BR2_LINUX_KERNEL=y
BR2_LINUX_KERNEL_CUSTOM_TARBALL=y
BR2_LINUX_KERNEL_CUSTOM_TARBALL_LOCATION="$(call github,Xilinx,linux-xlnx,xilinx-v2023.2)/xlnx-linux-v2023.2.tar.gz"
BR2_LINUX_KERNEL_DEFCONFIG="xilinx_zynq"
BR2_LINUX_KERNEL_CONFIG_FRAGMENT_FILES="$(BR2_EXTERNAL_ZYBO_PATH)/board/zybo-z7/linux.fragment"
BR2_LINUX_KERNEL_DTS_SUPPORT=y
BR2_LINUX_KERNEL_CUSTOM_DTS_PATH="$(BR2_EXTERNAL_ZYBO_PATH)/board/zybo-z7/zybo-z7.dts"
BR2_PACKAGE_LIBGPIOD=y
BR2_PACKAGE_LIBGPIOD_TOOLS=y
BR2_PACKAGE_DROPBEAR=y
BR2_TARGET_ROOTFS_EXT2=y
BR2_TARGET_ROOTFS_EXT2_4=y
BR2_TARGET_ROOTFS_EXT2_SIZE="128M"
# BR2_TARGET_ROOTFS_TAR is not set
BR2_TARGET_UBOOT=y
BR2_TARGET_UBOOT_BUILD_SYSTEM_KCONFIG=y
BR2_TARGET_UBOOT_CUSTOM_TARBALL=y
BR2_TARGET_UBOOT_CUSTOM_TARBALL_LOCATION="$(call github,Xilinx,u-boot-xlnx,xilinx-v2023.2)/xlnx-u-boot-v2023.2.tar.gz"
BR2_TARGET_UBOOT_BOARD_DEFCONFIG="xilinx_zynq_virt"
BR2_TARGET_UBOOT_NEEDS_DTC=y
BR2_TARGET_UBOOT_NEEDS_OPENSSL=y
BR2_TARGET_UBOOT_FORMAT_IMG=y
BR2_TARGET_UBOOT_SPL=y
BR2_TARGET_UBOOT_SPL_NAME="spl/boot.bin"
BR2_TARGET_UBOOT_CUSTOM_MAKEOPTS="DEVICE_TREE=zynq-zybo-z7"
BR2_PACKAGE_HOST_DOSFSTOOLS=y
BR2_PACKAGE_HOST_GENIMAGE=y
BR2_PACKAGE_HOST_MTOOLS=y
BR2_PACKAGE_ZYBO_MONITOR=y
```

## configs/zybo_z7_secure_defconfig
```kconfig
BR2_arm=y
BR2_cortex_a9=y
BR2_ARM_ENABLE_NEON=y
BR2_ARM_ENABLE_VFP=y
BR2_KERNEL_HEADERS_6_1=y
BR2_TARGET_GENERIC_HOSTNAME="zybo"
BR2_TARGET_GENERIC_ISSUE="Zybo Z7-20 / authenticated Buildroot"
# BR2_TARGET_ENABLE_ROOT_LOGIN is not set
BR2_TARGET_GENERIC_GETTY_PORT="ttyPS0"
BR2_SYSTEM_DHCP="eth0"
BR2_ROOTFS_OVERLAY="$(BR2_EXTERNAL_ZYBO_PATH)/board/zybo-z7/rootfs-overlay"
BR2_ROOTFS_POST_IMAGE_SCRIPT="$(BR2_EXTERNAL_ZYBO_PATH)/board/zybo-z7/post-image.sh"
BR2_ROOTFS_POST_SCRIPT_ARGS="--zybo-secure"
BR2_GLOBAL_PATCH_DIR="$(BR2_EXTERNAL_ZYBO_PATH)/board/zybo-z7/secure/patches"
BR2_LINUX_KERNEL=y
BR2_LINUX_KERNEL_CUSTOM_TARBALL=y
BR2_LINUX_KERNEL_CUSTOM_TARBALL_LOCATION="$(call github,Xilinx,linux-xlnx,xilinx-v2023.2)/xlnx-linux-v2023.2.tar.gz"
BR2_LINUX_KERNEL_DEFCONFIG="xilinx_zynq"
BR2_LINUX_KERNEL_CONFIG_FRAGMENT_FILES="$(BR2_EXTERNAL_ZYBO_PATH)/board/zybo-z7/linux.fragment $(BR2_EXTERNAL_ZYBO_PATH)/board/zybo-z7/secure/linux.fragment"
BR2_LINUX_KERNEL_DTS_SUPPORT=y
BR2_LINUX_KERNEL_CUSTOM_DTS_PATH="$(BR2_EXTERNAL_ZYBO_PATH)/board/zybo-z7/zybo-z7.dts"
BR2_TARGET_ROOTFS_CPIO=y
BR2_TARGET_ROOTFS_CPIO_GZIP=y
# BR2_TARGET_ROOTFS_TAR is not set
BR2_TARGET_UBOOT=y
BR2_TARGET_UBOOT_BUILD_SYSTEM_KCONFIG=y
BR2_TARGET_UBOOT_CUSTOM_TARBALL=y
BR2_TARGET_UBOOT_CUSTOM_TARBALL_LOCATION="$(call github,Xilinx,u-boot-xlnx,xilinx-v2023.2)/xlnx-u-boot-v2023.2.tar.gz"
BR2_TARGET_UBOOT_BOARD_DEFCONFIG="xilinx_zynq_virt"
BR2_TARGET_UBOOT_CONFIG_FRAGMENT_FILES="$(BR2_EXTERNAL_ZYBO_PATH)/board/zybo-z7/secure/uboot.fragment"
BR2_TARGET_UBOOT_NEEDS_DTC=y
BR2_TARGET_UBOOT_NEEDS_OPENSSL=y
BR2_TARGET_UBOOT_CUSTOM_MAKEOPTS="DEVICE_TREE=zynq-zybo-z7"
BR2_PACKAGE_HOST_DOSFSTOOLS=y
BR2_PACKAGE_HOST_GENIMAGE=y
BR2_PACKAGE_HOST_MTOOLS=y
BR2_PACKAGE_ZYBO_MONITOR=y
BR2_PACKAGE_ZYBO_HEALTH=y
BR2_PACKAGE_ZYBO_SECURE_BOOT=y
```

## package/zybo-btn/Config.in
```kconfig
config BR2_PACKAGE_ZYBO_BTN
	bool "zybo-btn"
	depends on BR2_LINUX_KERNEL
	help
	  Kernel driver for the Zybo Z7 MIO push buttons (BTN4/BTN5).
	  Debounced press/release events are read from /dev/zybo_btn.

comment "zybo-btn needs a Linux kernel to be built"
	depends on !BR2_LINUX_KERNEL
```

## package/zybo-health/Config.in
```kconfig
config BR2_PACKAGE_ZYBO_HEALTH
	bool "zybo-health"
	depends on BR2_LINUX_KERNEL
	select BR2_PACKAGE_ZYBO_BTN
	help
	  Bounded power-on checks and an application startup gate for Zybo Z7.

config BR2_PACKAGE_ZYBO_SECURE_BOOT
	bool "Zybo authenticated boot image packaging"
	depends on BR2_LINUX_KERNEL && BR2_TARGET_UBOOT && BR2_TARGET_ROOTFS_CPIO
	select BR2_PACKAGE_ZYBO_HEALTH
	select BR2_PACKAGE_HOST_PYTHON3
	select BR2_PACKAGE_HOST_DTC
	select BR2_PACKAGE_HOST_BOOTGEN
	help
	  Use with zybo_z7_secure_defconfig. Requires private signing keys,
	  an RSA-capable Zybo Z7-20 FSBL and the AMD Bootgen host tool.
```

## package/zybo-monitor/Config.in
```kconfig
config BR2_PACKAGE_ZYBO_MONITOR
	bool "zybo-monitor"
	depends on BR2_LINUX_KERNEL
	select BR2_PACKAGE_ZYBO_BTN
	help
	  Small daemon: button handling, LD4 control and XADC
	  temperature monitoring. Started from /etc/init.d.

comment "zybo-monitor needs a Linux kernel to be built"
	depends on !BR2_LINUX_KERNEL
```
